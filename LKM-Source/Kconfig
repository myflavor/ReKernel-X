## LKM-Source/Kconfig
```kconfig
menu "Re:Kernel"

config REKERNEL
	bool "Re:Kernel module"
	depends on MODULES
	default n
	help
	  Make tombstone users get a better experience.
	  Tips: Enabling this will build Re-Kernel as a module
endmenu
```
